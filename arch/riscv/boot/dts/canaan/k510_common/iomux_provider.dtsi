/* Copyright (c) 2022, Canaan Bright Sight Co., Ltd
 *
 * This program is free software; you can redistribute it and/or modify
 * it under the terms of the GNU General Public License version 2 as
 * published by the Free Software Foundation.
*/

&iomux {
    #pinctrl-cells = <1>;
    pinctrl-k510,register-width = <32>;
    pinctrl-k510,function-mask = <0xffffffff>;
};
