#include <dt-bindings/gpio/gpio.h>

&gpio {
    #address-cells = <1>;
    #size-cells = <0>;
    porta: gpio@0 {
        compatible = "snps,dw-apb-gpio-port";
        gpio-controller;
        #gpio-cells = <2>;
        snps,nr-gpios = <8>;
        reg = <0>;
        interrupt-controller;
        #interrupt-cells = <2>;
        interrupt-parent = <&plic0>;
        interrupts = <19 4>;
    };
};

