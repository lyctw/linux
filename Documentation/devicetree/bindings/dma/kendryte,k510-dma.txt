## Documentation/devicetree/bindings/dma/kendryte,k510-dma.txt
```
* Kendryte K510 System DMA Controller

Required properties:
- compatible: "Canaan,k510-sysdma"
- reg: Address range of the DMAC registers. Should contain the registers base address and length
- clocks: Should contain a reference to the parent clock
- interrupt-parent: Should be the phandle for the interrupt controller
- interrupts: 
- dma-channels: Number of DMA channels supported by the controller. The maximum value is 4.

Example:

    sysdma: dma-controller@93050000 {
        compatible = "Canaan,k510-sysdma";
        reg = <0x0 0x93050000 0x0 0x10000>;
        clocks = <&refclk>;
        interrupt-parent = <&plic0>;
        interrupts = <30 4>;
        dma-channels = <4>;
    };

* Kendryte K510 Peripherals DMA Controller

Required properties:
- compatible: "Canaan,k510-peridma"
- reg: Address range of the DMAC registers. Should contain the registers base address and length 
- dma-cells: Should be 4. For more details, please refer to the DMA client binding below
- clocks: Should contain a reference to the parent clock   
- interrupt-parent: Should be the phandle for the interrupt controller 
- interrupts: 
- dma-channels: Number of DMA channels supported by the controller. The maximum value is 16
- dma-requests: Number of DMA request signals supported by the controller

Example:
	
    peridma: dma-controller@93040000 {
        compatible = "Canaan,k510-peridma";
        reg = <0x0 0x93040000 0x0 0x10000>;
        #dma-cells = <4>;
        clocks = <&refclk>;
        interrupt-parent = <&plic0>;
        interrupts = <31 4>;
        dma-channels = <16>;
        dma-requests = <35>;
    };

* Clients

DMA clients connected to the Kendryte Peripherals DMA controller must use the format described in
the dma.txt file, using a five-cell specifier for each channel.
The five cells in order are:

1. A phandle pointing to the DMA controller
2. The priority of the dma channel. The valid value can be 1 to 15.
3. Channel response waiting timeout time.
4. Data endian configuration. 
   0x0: Default configuration without any adjustment 
   0x1: The transmission length is two bytes, and endian conversions are performed.
   0x2: The transmission length is four bytes, and endian conversions are performed.  
   0x3: The transmission length is eight bytes, and endian conversions are performed.  
5. Choose peripherals.

Example:

	sha256: sha256-controller@91010000 {
        compatible = "kendryte,k510-sha256";
        reg = <0x0 0x91010000 0x0 0x10000>;
        clocks = <&refclk>;
        status = "okay";
        dmas = <&peridma 1 0xfff 0 0x20>;
        dma-names = "tx";
    };
```

## Documentation/devicetree/bindings/mfd/andestech,atcsmu.yaml
```yaml
# SPDX-License-Identifier: (GPL-2.0-only OR BSD-2-Clause)
%YAML 1.2
---
$id: http://devicetree.org/schemas/mfd/andestech,atcsmu.yaml#
$schema: http://devicetree.org/meta-schemas/core.yaml#

title: Andes Technology System Management Unit (SMU)

maintainers:
  - Dylan Jhong <dylan@andestech.com>
  - Yu Chien Peter Lin <peterlin@andestech.com>

description:
  SMU provides versatile system management capabilities, including
  clock, reset and power control based on power domain partitions.

properties:
  compatible:
    items:
      - const: andestech,atcsmu

  reg:
    maxItems: 1

required:
  - reg

additionalProperties: false

examples:
  - |
    soc {
        #address-cells = <2>;
        #size-cells = <2>;

        smu: smu@f0100000 {
          compatible = "andestech,atcsmu";
          reg = <0x00000000 0xf0100000 0x00000000 0x00001000>;
        };
    };
```

## Documentation/devicetree/bindings/soc/andes/andestech,plicsw.yaml
```yaml
# SPDX-License-Identifier: (GPL-2.0-only OR BSD-2-Clause)
%YAML 1.2
---
$id: http://devicetree.org/schemas/soc/andes/andestech,plicsw.yaml#
$schema: http://devicetree.org/meta-schemas/core.yaml#

title: Andes Technology Software Interrupt Controller

maintainers:
  - Dylan Jhong <dylan@andestech.com>
  - Yu Chien Peter Lin <peterlin@andestech.com>

description:
  PLICSW is used to request inter-processor interrupt in M-mode, which
  is an implementation akin to PLIC with software programmable memory
  mapped registers according to RISC-V PLIC specification.

properties:
  compatible:
    items:
      - const: andestech,plicsw

  reg:
    maxItems: 1

  interrupts-extended:
    minItems: 1
    maxItems: 8

additionalProperties: true

required:
  - compatible
  - reg
  - interrupts-extended

examples:
  - |
    soc {
        #address-cells = <2>;
        #size-cells = <2>;

        plicsw: interrupt-controller@e6400000 {
          #interrupt-cells = <2>;
          compatible = "andestech,plicsw";
          reg = <0x00 0xe6400000 0x00 0x00400000>;
          interrupts-extended = <&CPU0_intc 3
                                 &CPU1_intc 3
                                 &CPU2_intc 3
                                 &CPU3_intc 3>;
          interrupt-controller;
          riscv,ndev = <4>;
        };
    };
```

## Documentation/devicetree/bindings/soc/andes/andestech,plmt0.yaml
```yaml
# SPDX-License-Identifier: (GPL-2.0-only OR BSD-2-Clause)
%YAML 1.2
---
$id: http://devicetree.org/schemas/soc/andes/andestech,plmt0.yaml#
$schema: http://devicetree.org/meta-schemas/core.yaml#

title: Andes Technology NCEPLMT100 Machine Timer

maintainers:
  - Dylan Jhong <dylan@andestech.com>
  - Yu Chien Peter Lin <peterlin@andestech.com>

description:
  The RISC-V architecture defines a machine timer that provides a
  real-time counter and generates timer interrupts. NCEPLMT100 is an
  implementation of the machine timer.
  This timer is not to be confused with the real-time clock timer (RTC)
  of typical computing platforms. Per RISC-V privileged specification,
  the timer clock could be clocked at any arbitrary frequency as long as
  it is a fixed frequency clock that is not affected by clock gating or
  frequency scaling of clocks in the rest of the platform.

properties:
  compatible:
    items:
      - const: andestech,plmt0

  reg:
    maxItems: 1

  interrupts-extended:
    minItems: 1
    maxItems: 8

additionalProperties: false

required:
  - compatible
  - reg
  - interrupts-extended

examples:
  - |
    soc {
        #address-cells = <2>;
        #size-cells = <2>;

        plmt0: plmt0@e6000000 {
          compatible = "andestech,plmt0";
          reg = <0x00000000 0xe6000000 0x00000000 0x00100000>;
          interrupts-extended = <&CPU0_intc 7
                                 &CPU1_intc 7
                                 &CPU2_intc 7
                                 &CPU3_intc 7>;
        };
    };
```

## Documentation/devicetree/bindings/watchdog/andestech,atcwdt200.yaml
```yaml
# SPDX-License-Identifier: (GPL-2.0-only OR BSD-2-Clause)
%YAML 1.2
---
$id: http://devicetree.org/schemas/watchdog/andestech,atcwdt200.yaml#
$schema: http://devicetree.org/meta-schemas/core.yaml#

title: Andes Technology ATCWDT200 watchdog

maintainers:
  - Dylan Jhong <dylan@andestech.com>
  - Yu Chien Peter Lin <peterlin@andestech.com>

description: |
  The ATCWDT200 watchdog timer is an IP pre-integrated as APB bus
  component on AE350 platform.

allOf:
  - $ref: "watchdog.yaml#"

properties:
  compatible:
    items:
      - const: andestech,atcwdt200

  reg:
    maxItems: 1

  clock-frequency:
    default: 15000000

additionalProperties: true

required:
  - compatible
  - reg
  - clock-frequency

examples:
  - |
    soc {
        #address-cells = <2>;
        #size-cells = <2>;

        watchdog: watchdog@f0500000 {
          compatible = "andestech,atcwdt200";
          reg = <0x00 0xf0500000 0x00 0x00001000>;
          interrupts = <3 4>;
          interrupt-parent = <&plic0>;
          clock-frequency = <15000000>;
        };
    };
```

## arch/riscv/configs/ae350_a45mp_defconfig
```kconfig
CONFIG_SYSVIPC=y
CONFIG_POSIX_MQUEUE=y
CONFIG_NO_HZ_IDLE=y
CONFIG_HIGH_RES_TIMERS=y
CONFIG_BPF_SYSCALL=y
CONFIG_IKCONFIG=y
CONFIG_IKCONFIG_PROC=y
CONFIG_CGROUPS=y
CONFIG_CGROUP_SCHED=y
CONFIG_CFS_BANDWIDTH=y
CONFIG_CGROUP_BPF=y
CONFIG_NAMESPACES=y
CONFIG_USER_NS=y
CONFIG_CHECKPOINT_RESTORE=y
CONFIG_BLK_DEV_INITRD=y
CONFIG_INITRAMFS_SOURCE=""
CONFIG_EXPERT=y
# CONFIG_SYSFS_SYSCALL is not set
CONFIG_PROFILING=y
CONFIG_PLAT_AE350=y
CONFIG_ARCH_RV32I=y
CONFIG_CMODEL_MEDANY=y
CONFIG_SMP=y
CONFIG_HOTPLUG_CPU=y
CONFIG_PM=y
CONFIG_CPU_IDLE=y
CONFIG_RISCV_SBI_CPUIDLE=y
CONFIG_VIRTUALIZATION=y
CONFIG_KVM=m
CONFIG_JUMP_LABEL=y
# CONFIG_COMPAT_32BIT_TIME is not set
CONFIG_MODULES=y
CONFIG_MODULE_UNLOAD=y
CONFIG_NET=y
CONFIG_PACKET=y
CONFIG_UNIX=y
CONFIG_INET=y
CONFIG_IP_MULTICAST=y
CONFIG_IP_ADVANCED_ROUTER=y
CONFIG_IP_PNP=y
CONFIG_IP_PNP_DHCP=y
CONFIG_IP_PNP_BOOTP=y
CONFIG_IP_PNP_RARP=y
CONFIG_NETLINK_DIAG=y
CONFIG_NET_9P=y
CONFIG_NET_9P_VIRTIO=y
CONFIG_PCI=y
CONFIG_PCIEPORTBUS=y
CONFIG_PCI_HOST_GENERIC=y
CONFIG_PCIE_XILINX=y
CONFIG_DEVTMPFS=y
CONFIG_DEVTMPFS_MOUNT=y
CONFIG_BLK_DEV_LOOP=y
CONFIG_VIRTIO_BLK=y
CONFIG_BLK_DEV_NVME=m
CONFIG_BLK_DEV_SD=y
CONFIG_BLK_DEV_SR=y
CONFIG_SCSI_VIRTIO=y
CONFIG_ATA=y
CONFIG_SATA_AHCI=y
CONFIG_SATA_AHCI_PLATFORM=y
CONFIG_NETDEVICES=y
CONFIG_VIRTIO_NET=y
CONFIG_MACB=y
CONFIG_FTMAC100=y
CONFIG_E1000E=y
CONFIG_R8169=y
CONFIG_MICROSEMI_PHY=y
CONFIG_INPUT_MOUSEDEV=y
CONFIG_SERIAL_8250=y
CONFIG_SERIAL_8250_CONSOLE=y
CONFIG_SERIAL_OF_PLATFORM=y
CONFIG_VIRTIO_CONSOLE=y
CONFIG_HW_RANDOM=y
CONFIG_HW_RANDOM_VIRTIO=y
CONFIG_I2C=m
CONFIG_SPI=y
CONFIG_SPI_SIFIVE=y
# CONFIG_PTP_1588_CLOCK is not set
CONFIG_GPIOLIB=y
CONFIG_GPIO_SIFIVE=y
CONFIG_POWER_RESET=y
CONFIG_POWER_RESET_SYSCON=y
CONFIG_POWER_RESET_SYSCON_POWEROFF=y
CONFIG_POWER_SUPPLY=y
CONFIG_FB=y
CONFIG_BACKLIGHT_CLASS_DEVICE=m
CONFIG_FRAMEBUFFER_CONSOLE=y
CONFIG_FRAMEBUFFER_CONSOLE_DETECT_PRIMARY=y
CONFIG_USB=y
CONFIG_USB_XHCI_HCD=y
CONFIG_USB_XHCI_PLATFORM=y
CONFIG_USB_EHCI_HCD=y
CONFIG_USB_EHCI_HCD_PLATFORM=y
CONFIG_USB_OHCI_HCD=y
CONFIG_USB_OHCI_HCD_PLATFORM=y
CONFIG_USB_STORAGE=y
CONFIG_USB_UAS=y
CONFIG_MMC=y
CONFIG_MMC_FTSDCG=y
CONFIG_RTC_CLASS=y
CONFIG_RTC_DRV_ATCRTC100=y
CONFIG_RTC_DRV_GOLDFISH=y
CONFIG_DMADEVICES=y
CONFIG_ATCDMAC300G=y
CONFIG_SYNC_FILE=y
CONFIG_VIRTIO_PCI=y
CONFIG_VIRTIO_BALLOON=y
CONFIG_VIRTIO_INPUT=y
CONFIG_VIRTIO_MMIO=y
CONFIG_GOLDFISH=y
CONFIG_RPMSG_CHAR=y
CONFIG_RPMSG_CTRL=y
CONFIG_RPMSG_VIRTIO=y
CONFIG_EXT4_FS=y
CONFIG_EXT4_FS_POSIX_ACL=y
CONFIG_AUTOFS4_FS=y
CONFIG_MSDOS_FS=y
CONFIG_VFAT_FS=y
CONFIG_TMPFS=y
CONFIG_TMPFS_POSIX_ACL=y
CONFIG_HUGETLBFS=y
CONFIG_NFS_FS=y
CONFIG_NFS_V4=y
CONFIG_NFS_V4_1=y
CONFIG_NFS_V4_2=y
CONFIG_ROOT_NFS=y
CONFIG_9P_FS=y
CONFIG_NLS_CODEPAGE_437=y
CONFIG_NLS_ISO8859_1=m
CONFIG_CRYPTO_USER_API_HASH=y
CONFIG_CRYPTO_DEV_VIRTIO=y
CONFIG_CRC_ITU_T=y
CONFIG_CRC7=y
CONFIG_PRINTK_TIME=y
CONFIG_FRAME_WARN=2048
CONFIG_DEBUG_FS=y
CONFIG_DEBUG_PAGEALLOC=y
CONFIG_PTDUMP_DEBUGFS=y
CONFIG_SCHED_STACK_END_CHECK=y
CONFIG_DEBUG_VM=y
CONFIG_DEBUG_VM_PGFLAGS=y
CONFIG_DEBUG_VIRTUAL=y
CONFIG_DEBUG_MEMORY_INIT=y
CONFIG_DEBUG_PER_CPU_MAPS=y
CONFIG_SOFTLOCKUP_DETECTOR=y
CONFIG_WQ_WATCHDOG=y
CONFIG_DEBUG_TIMEKEEPING=y
CONFIG_DEBUG_RT_MUTEXES=y
CONFIG_DEBUG_SPINLOCK=y
CONFIG_DEBUG_MUTEXES=y
CONFIG_DEBUG_RWSEMS=y
CONFIG_STACKTRACE=y
CONFIG_DEBUG_LIST=y
CONFIG_DEBUG_PLIST=y
CONFIG_DEBUG_SG=y
# CONFIG_RCU_TRACE is not set
CONFIG_RCU_EQS_DEBUG=y
# CONFIG_FTRACE is not set
# CONFIG_RUNTIME_TESTING_MENU is not set
CONFIG_MEMTEST=y
```

## drivers/clk/canaan/Kconfig
```kconfig
config COMMON_CLK_CAN_K510
	tristate "Clock driver for Canaan K510 soc"
	depends on RISCV
	---help---
	   clock driver for the K510 SoC using common clock framework.
```

## drivers/crypto/kendryte/Kconfig
```kconfig
config CRYPTO_DEV_KENDRYTE_TRNG
	tristate "Support for KENDRYTE TRNG hardware"
	select CRYPTO_RNG
	help
          This driver interfaces with the TRNG hardware.

config CRYPTO_DEV_KENDRYTE_HASH
	tristate "Support for KENDRYTE hash accelerators"
	select CRYPTO_HASH
	select CRYPTO_SHA256
	help
          This driver interfaces with the hardware hash accelerator. 
	  Supporting SHA256 hashing algorithm.

config CRYPTO_DEV_KENDRYTE_CRYP
	tristate "Support for KENDRYTE cryp accelerators"
	select CRYPTO_AES
	select CRYPTO_BLKCIPHER
	help
          This driver interfaces with the hardware crypto accelerator.
	  Supporting cbc/ecb/ofb/cfb/gcm.
```

## drivers/gpu/drm/canaan/Kconfig
```kconfig
config DRM_KENDRYTE
	tristate "DRM Support for kendryte 510"
	depends on DRM
	select DRM_GEM_CMA_HELPER
	select DRM_KMS_HELPER
	select DRM_KMS_CMA_HELPER
	select DRM_PANEL
	select VIDEOMODE_HELPERS
	select DRM_MIPI_DSI if KENDRYTE_CADENCE_MIPI_DSI
	help
	  Choose this option if you have a kendryte k510 soc chipset.
	  This driver provides kernel mode setting and buffer
	  management to userspace. This driver does not provide
	  2D or 3D acceleration; acceleration is performed by other
	  IP found on the SoC.


config KENDRYTE_CADENCE_MIPI_DSI
	bool "kendryte specific extensions for cadence  MIPI DSI"
	help
	 This selects support for kendryte SoC specific extensions
	 for the cadence DesignWare dsi driver. If you want to
	 enable MIPI DSI on k510 based SoC, you should selet this
	 option.
```

## drivers/media/i2c/soc_camera/canaanchip/Kconfig
```kconfig
config VIDEO_IMX219_0
	tristate "Sony IMX219 sensor support"
	depends on I2C && VIDEO_V4L2 && VIDEO_V4L2_SUBDEV_API && VIDEO_CANAAN_K510
	depends on MEDIA_CAMERA_SUPPORT
	---help---
	  This is a V4L2 sensor-level driver for the Sony IMX219
	  CMOS image sensor.
config VIDEO_IMX219_1
	tristate "Sony IMX219 sensor support"
	depends on I2C && VIDEO_V4L2 && VIDEO_V4L2_SUBDEV_API && VIDEO_CANAAN_K510
	depends on MEDIA_CAMERA_SUPPORT
	---help---
	  This is a V4L2 sensor-level driver for the Sony IMX219
	  CMOS image sensor.

config VIDEO_IMX385
	tristate "Sony IMX385 sensor support"
	depends on I2C && VIDEO_V4L2 && VIDEO_V4L2_SUBDEV_API && VIDEO_CANAAN_K510
	depends on MEDIA_CAMERA_SUPPORT
	---help---
	  This is a V4L2 sensor-level driver for the Sony IMX385
	  CMOS image sensor.
```

## drivers/media/platform/canaan-isp/Kconfig
```kconfig
#
# Platform drivers
#

config VIDEO_CANAAN_K510
	tristate "canaan k510 Camera support"
	depends on VIDEO_V4L2 && I2C && VIDEO_V4L2_SUBDEV_API
    depends on HAS_DMA && OF
    depends on HAS_IOMEM
	select VIDEOBUF2_DMA_CONTIG
	select MFD_SYSCON
	select V4L2_FWNODE
	---help---
	  Driver for an canaan k510 camera controller.
```

## drivers/media/platform/canaan/Kconfig
```kconfig
    config K510_ISP_TEST_DRIVER
        tristate "k510 isp test driver"
        depends on HAS_DMA
        depends on HAS_IOMEM
        help
          Say Y for enabling the k510 isp test driver

          To compile this support as a module, choose M here:
          The module will be called allegro_encoder.
          If unsure, say N.

    config K510_2D_DRIVER
        tristate "k510 2d test driver"
        depends on HAS_DMA
        depends on HAS_IOMEM
        help
          Say Y for enabling the k510 2d test driver

          To compile this support as a module, choose M here:
          The module will be called allegro_encoder.
          If unsure, say N.

source "drivers/media/platform/canaan/al5r/Kconfig"
```

## drivers/memory/canaan/Kconfig
```kconfig
config CANAAN_MEMORY
        tristate "Canaan memory driver"
        help
          Say Y for enabling the k510 shared memory management driver

          To compile this support as a module, choose M here:
          The module will be called allegro_encoder.
          If unsure, say N.
```

## drivers/misc/canaan/Kconfig
```kconfig
menu "Canaan k510 drivers"

source "drivers/misc/canaan/i2c/Kconfig"
source "drivers/misc/canaan/gnne/Kconfig"
source "drivers/misc/canaan/k510-dsp/Kconfig"
source "drivers/misc/canaan/k510-share-memory/Kconfig"

endmenu
```
