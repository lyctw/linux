## drivers/misc/canaan/gnne/Kconfig
```kconfig
    config K510_GNNE_DRIVER
        tristate "K510 GNNE test driver"
        depends on HAS_DMA
        depends on HAS_IOMEM
        help
          Say Y for enabling the k510 gnne test driver

          To compile this support as a module, choose M here:
          The module will be called allegro_encoder.
          If unsure, say N.
```

## drivers/misc/canaan/i2c/Kconfig
```kconfig
    config I2C0_TEST_DRIVER
        tristate "i2c0 test driver"
        depends on HAS_DMA
        depends on HAS_IOMEM
        help
          Say Y for enabling the i2c0 test driver

          To compile this support as a module, choose M here:
          The module will be called allegro_encoder.
          If unsure, say N.
```

## drivers/misc/canaan/k510-share-memory/Kconfig
```kconfig
config CANAAN_MEMORY_CMA
        tristate "Canaan memory driver(cma version)"
        depends on CMA 
        help
          Say Y for enabling the k510 shared memory management driver using cma

          To compile this support as a module, choose M here:
          The module will be called allegro_encoder.
          If unsure, say N.
```

## drivers/pinctrl/canaan/Kconfig
```kconfig
config PINCTRL_K510
        tristate "K510 pinctrl driver"
        depends on OF
        depends on HAS_IOMEM
        select GENERIC_PINCTRL_GROUPS
        select GENERIC_PINMUX_FUNCTIONS
        select GENERIC_PINCONF
        help
          This selects the pinctrl driver for K510.
```

## drivers/reset/canaan/Kconfig
```kconfig
config COMMON_RESET_K510
	tristate "k510 Reset Driver"
	depends on RISCV
	help
	  Build the Canaan K510 reset driver.
```

## drivers/soc/andes/Kconfig
```kconfig
# SPDX-License-Identifier: GPL-2.0

if PLAT_AE350

config ATCSMU
	bool "ATCSMU Support"
	depends on RISCV && PLAT_AE350
	help
	  SMU is typically used to program reset vectors
	  before WDT triggers software reset.
	  Say N here if you want to disable SMU support

endif
```

## drivers/soc/canaan/Kconfig
```kconfig
menu "Canaan SoC drivers"

config CANAAN_PM_DOMAIN
        bool "Canaan power domain driver"
        select PM_GENERIC_DOMAINS
endmenu
```

## drivers/video/canaan/twod/Kconfig
```kconfig
menuconfig KENDRYTE_TWOD_SUPPORT
        bool "kendryte twod device support"
        help
          Enable this to be able to choose the drivers for controlling the
          twod on some platforms, for example on PDAs.


config KENDRYTE_TWOD
	tristate "kendryte twod"
	help
	  kendryte 510 twod module.
```

## sound/soc/canaan/Kconfig
```kconfig
config SND_SOC_CANAAN_MAX98090
	tristate "ASoC support for CANAAN boards using a MAX98090 codec"
	depends on I2C && GPIOLIB && CLKDEV_LOOKUP
	help
	  Say Y or M here if you want to add support for SoC audio on CANAAN
	  boards using the MAX98090 codec.

config SND_SOC_CANAAN_NAU8822
	tristate "ASoC support for CANAAN boards using a NAU8822 codec"
	depends on I2C && GPIOLIB && CLKDEV_LOOKUP
	help
	  Say Y or M here if you want to add support for SoC audio on CANAAN
	  boards using the NAU8822 codec.

config SND_SOC_CANAAN_AUDIO
	tristate "CANAAN AUDIO interface support"
	help
	  Say Y or M here if you want to enable audio for canaan soc.
```
